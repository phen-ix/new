## fs/nomount/Kconfig
```kconfig
# Kconfig for NoMount
# Vendored from maxsteeel/nomount v2.3.0-720 (ab93ee32a589ccb021257b3c1f280e058520d844),
# wire protocol / base version 23.

config NOMOUNT
	tristate "NoMount Path Redirection Subsystem"
	depends on KEYS
	default n
	help
	  NoMount allows path redirection and virtual file injection
	  without mounting filesystems. Useful for systemless modifications.
```
